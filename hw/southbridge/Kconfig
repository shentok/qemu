## hw/southbridge/Kconfig
```kconfig
# SPDX-License-Identifier: GPL-2.0-or-later

config ICH9
    bool
    depends on PCI_EXPRESS
    imply I82801B11
    select AHCI_ICH9
    select ACPI_ICH9
    imply USB_EHCI_PCI
    imply USB_UHCI
```
